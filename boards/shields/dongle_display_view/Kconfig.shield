## boards/shields/dongle_display_view/Kconfig.shield
```kconfig
# Copyright (c) 2022 The ZMK Contributors
# SPDX-License-Identifier: MIT

config SHIELD_DONGLE_DISPLAY_VIEW_PRO_MICRO
    def_bool $(shields_list_contains,dongle_display_view_pro_micro)

config SHIELD_DONGLE_DISPLAY_VIEW_SEEEDUINO_XIAO_BLE
    def_bool $(shields_list_contains,dongle_display_view_seeeduino_xiao_ble)
```

## config/west.yml
```yaml
manifest:
  remotes:
    - name: urob
      url-base: https://github.com/urob
    - name: mctechnology17
      url-base: https://github.com/mctechnology17
  projects:
    # zmk firmware by @urob
    - name: zmk
      remote: urob
      revision: main
      import: app/west.yml

    # include corne with dongle pro_micro and xiao compatible
    - name: zmk-config
      remote: mctechnology17
      revision: main
  self:
    path: config
```
